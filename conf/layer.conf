## conf/layer.conf
```bitbake
BBPATH =. "${LAYERDIR}:"
BBFILES += "${LAYERDIR}/recipes-*/*/*.bb ${LAYERDIR}/recipes-*/*/*.bbappend"

BBFILE_COLLECTIONS += "meta-forgejo"
BBFILE_PATTERN_meta-forgejo = "^${LAYERDIR}/"
BBFILE_PRIORITY_meta-forgejo = "6"

LAYERDEPENDS_meta-forgejo = "core meta-albertow"
LAYERSERIES_COMPAT_meta-forgejo = "wrynose"
```
